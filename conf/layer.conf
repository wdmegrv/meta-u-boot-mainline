## conf/layer.conf
```bitbake
# Copyright (C) 2026, meta-u-boot-mainline contributors
# SPDX-License-Identifier: MIT

BBPATH .= ":${LAYERDIR}"

BBFILES += "${LAYERDIR}/recipes-*/*/*.bb \
            ${LAYERDIR}/recipes-*/*/*.bbappend"

BBFILE_COLLECTIONS += "meta-u-boot-mainline"
BBFILE_PATTERN_meta-u-boot-mainline := "^${LAYERDIR}/"
BBFILE_PRIORITY_meta-u-boot-mainline = "5"

LAYERSERIES_COMPAT_meta-u-boot-mainline = "wrynose blacksail"
LAYERDEPENDS_meta-u-boot-mainline = "core"
```
